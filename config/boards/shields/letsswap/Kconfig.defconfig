## config/boards/shields/letsswap/Kconfig.defconfig
```kconfig
if SHIELD_LETSSWAP_LEFT

config ZMK_KEYBOARD_NAME
    default "Let's Swap"

config ZMK_SPLIT_ROLE_CENTRAL
    default y

endif

if SHIELD_LETSSWAP_LEFT || SHIELD_LETSSWAP_RIGHT

config ZMK_SPLIT
    default y

endif
```

## config/boards/shields/letsswap/Kconfig.shield
```kconfig
config SHIELD_LETSSWAP_LEFT
    def_bool $(shields_list_contains,letsswap_left)

config SHIELD_LETSSWAP_RIGHT
    def_bool $(shields_list_contains,letsswap_right)
```

## config/boards/shields/tabla60/Kconfig.defconfig
```kconfig
if SHIELD_TABLA60_LEFT

config ZMK_KEYBOARD_NAME
    default "Tabla60"

config ZMK_SPLIT_ROLE_CENTRAL
    default y

endif

if SHIELD_TABLA60_LEFT || SHIELD_TABLA60_RIGHT

config ZMK_SPLIT
    default y

endif
```

## config/boards/shields/tabla60/Kconfig.shield
```kconfig
config SHIELD_TABLA60_LEFT
    def_bool $(shields_list_contains,tabla60_left)

config SHIELD_TABLA60_RIGHT
    def_bool $(shields_list_contains,tabla60_right)
```

## config/boards/shields/tatata64sbt/Kconfig.defconfig
```kconfig
if SHIELD_TATATA64SBT_LEFT

config ZMK_KEYBOARD_NAME
    default "Tatata64S BT"

config ZMK_SPLIT_ROLE_CENTRAL
    default y

endif

if SHIELD_TATATA64SBT_LEFT || SHIELD_TATATA64SBT_RIGHT

config ZMK_SPLIT
    default y

endif
```
